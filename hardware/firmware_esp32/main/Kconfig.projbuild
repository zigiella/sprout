## hardware/firmware_esp32/main/Kconfig.projbuild
```kconfig
menu "Sprout firmware"

choice SPROUT_BOARD_PROFILE
    prompt "Sprout board profile"
    default SPROUT_BOARD_PROFILE_N16R8_USB_OTG
    help
        Select the physical ESP32-S3 board profile without coupling the
        firmware state machine to a single board layout.

    config SPROUT_BOARD_PROFILE_N16R8_USB_OTG
        bool "ESP32-S3 N16R8 USB OTG"

    config SPROUT_BOARD_PROFILE_DEVKITC_N8R8
        bool "ESP32-S3-DevKitC-1 N8R8"
endchoice

config SPROUT_HEARTBEAT_INTERVAL_MS
    int "Heartbeat interval (ms)"
    range 500 10000
    default 2000
    help
        Cadence for HEARTBEAT lines emitted by the milestone-0 firmware.

config SPROUT_COMMAND_MAX_LINE_LENGTH
    int "Maximum serial command length"
    range 32 512
    default 128
    help
        Maximum ASCII line length accepted from the host for the hito-0
        serial protocol.

config SPROUT_HOST_HEARTBEAT_TIMEOUT_MS
    int "Host heartbeat freshness timeout (ms)"
    range 1000 60000
    default 5000
    help
        Maximum age of the most recent host heartbeat before the Rhizome
        link is considered stale.

config SPROUT_TANK_MINIMUM_PCT
    int "Minimum tank level percentage"
    range 0 100
    default 20
    help
        Hard floor for the reservoir level. Watering commands are rejected
        when the current tank level percentage is known and falls below
        this threshold.

config SPROUT_MAX_WATER_SECONDS
    int "Maximum watering seconds per event"
    range 1 600
    default 30
    help
        Hard upper bound for a single WATER event in the ESP32 safety layer.

config SPROUT_I2C_SCAN_BUFFER_BYTES
    int "I2C scan output buffer bytes"
    range 16 256
    default 96
    help
        Maximum number of bytes reserved to serialise the output list of
        detected I2C addresses for the `I2C_SCAN` command.

config SPROUT_SOIL_A_ADC_GPIO
    int "Soil A analog GPIO"
    range 0 48
    default 4
    help
        ADC-capable GPIO used for the MVP DFRobot capacitive soil moisture
        sensor. The baseline wiring uses GPIO4, which maps to ADC1 channel 3
        on ESP32-S3 and does not conflict with BME280 I2C or the pump relay.

config SPROUT_PUMP_RELAY_GPIO
    int "Pump relay GPIO"
    range 0 48
    default 16
    help
        GPIO used for the single-line MVP pump relay test output. The relay is
        powered from ESP32 3V3 and verified active-low in the bench module, so
        the firmware drives this GPIO high as the safe OFF state.

config SPROUT_PUMP_TEST_MAX_MS
    int "Maximum pump relay test pulse (ms)"
    range 50 30000
    default 30000
    help
        Maximum duration accepted by the PUMP_PULSE bench command. WATER
        remains DRY_RUN; this command is only for controlled relay bring-up.

endmenu
```

## hardware/firmware_esp32/sdkconfig.defaults
```kconfig
CONFIG_ESP_CONSOLE_USB_SERIAL_JTAG=y
CONFIG_SPIRAM=y
CONFIG_SPIRAM_MODE_OCT=y
CONFIG_SPIRAM_TYPE_AUTO=y
CONFIG_SPROUT_BOARD_PROFILE_N16R8_USB_OTG=y
CONFIG_SPROUT_HEARTBEAT_INTERVAL_MS=2000
CONFIG_SPROUT_COMMAND_MAX_LINE_LENGTH=128
CONFIG_SPROUT_HOST_HEARTBEAT_TIMEOUT_MS=5000
CONFIG_SPROUT_TANK_MINIMUM_PCT=20
CONFIG_SPROUT_MAX_WATER_SECONDS=30
```
